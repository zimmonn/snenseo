## modules/Kconfig
```kconfig
rsource "snenseo_machine/Kconfig"
rsource "ble_connection/Kconfig"
rsource "snenseo_time/Kconfig"
```

## modules/ble_connection/Kconfig
```kconfig
menu "Configure Snenseo BLE Connection & Service"

config SNENSEO_BLE_CONNECTION
  bool "Enable Snenseo BLE connection"
  depends on BT && BT_PERIPHERAL

config SNENSEO_BLE_CONNECTION_LOG_LEVEL 
  int "Set log level for the BLE connection"
  default 3
  depends on SNENSEO_BLE_CONNECTION && LOG


config SNENSEO_BLE_SERVICES_DEV_NAME
  string "Name to be used in Advertising"
  default "Snenseo"
  depends on SNENSEO_BLE_CONNECTION

config SNENSEO_BLE_SVC_LOG_LEVEL 
  int "Set log level for the BLE connection"
  default 3
  depends on SNENSEO_BLE_CONNECTION && LOG

endmenu
```

## modules/snenseo_machine/Kconfig
```kconfig
menu "Configure Snenseo machine" 

config SNENSEO_MACHINE
  bool "Enable the Snenseo Machine Module"
  default n
  depends on GPIO
  
config SNENSEO_MACHINE_LOG_LEVEL
  int "Set log level of Snenseo machine"
  default 3
  depends on SNENSEO_MACHINE && LOG

config SNENSEO_MACHINE_PULE_PERIOD
  int "Set pulse period for button press in ms"
  default 500
  depends on SNENSEO_MACHINE

endmenu
```

## modules/snenseo_time/Kconfig
```kconfig
menu "Configure Snenseo time" 

config SNENSEO_TIME
  bool "Enable the Snenseo Machine module"
  default n
  depends on RTC
  
config SNENSEO_TIME_LOG_LEVEL
  int "Set log level of Snenseo time module"
  default 3
  depends on SNENSEO_TIME && LOG

config SNENSEO_TIME_SLEEP_PERIOD
  int "Set sleep period of polling RTC time"
  default 2000
  depends on SNENSEO_TIME

config SNENSEO_TIME_STACK_SIZE
  int "Default stack size for Snenseo time module"
  default 1024
  depends on SNENSEO_TIME

config SNENSEO_TIME_THREAD_PRIO
  int "Default prio for Snenseo time module thread"
  default 7
  depends on SNENSEO_TIME

endmenu
```
